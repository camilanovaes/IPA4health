#include <Adafruit_GFX.h>    // Core graphics library
#include <Adafruit_ST7735.h> // Hardware-specific library
#include <SPI.h>
#include <Wire.h>
#include "MAX30100_PulseOximeter.h"
//
// Screen coordinates
//      0        X (160)   159
//    0 +------------------>
//      |
//   Y  |
// (128)|
//      |
//  127 V
//
#define TFT_CS     10 // pino CS_Display
#define TFT_RST    8  // pino RST_Display 
#define TFT_DC     9  // pino DC_Display
Adafruit_ST7735 tft = Adafruit_ST7735(TFT_CS,  TFT_DC, TFT_RST); // objeto utilizado para controlar o display
PulseOximeter pox; // objeto utilizado para obter os dados do sensor
MAX30100 sensor;   // objeto utilizado para controlar o sensor
#define UPPER_PULSE_RATE    220  // maior valor para o bpm
char cStringArray[100];     // Temp string array used to print numbers to the TFT display
int iBPM = 0;    // Valor atual dos batimentos cardiacos mostrado no display
int iBPMOld = 0; // Valor anterior dos batimentos mostrado no display
int SPO2 = 0;    // Valor atual da porcentagem de oxigenio mostrado no display
int SPO2Old = 0; // Valor anterior da porcentagem de oxigenio mostrado no display
uint32_t tsLastReport = 0; // Variavel utilizada para controlar o periodo de atualizacao da amostragem
int TempAudioValue = 0;  //
int MaxAudioValue = 0;   //
int MinAudioValue = 0;   //
uint32_t LastUpdate = 0; //
boolean FirstUpdate = true;  //
boolean StartUpdate = false; //
int FirstSamples = 0;  //
int outputValue = 0;   //
#define analogInPin A0 //
#define UpdateAudioValue 5000 //
#define REPORTING_PERIOD_MS 1000 // Periodo de amostragem, em milissegundos
#define BMO_COLOR 0x07FA //0,63,26
const unsigned char BMO_Blink [] PROGMEM = {
  0x00, 0x00, 0x00, 0x00, 0x00, 0x00, 0x00, 0x00, 0x00, 0x00, 0x00, 0x00, 0x00, 0x00, 0x00, 0x00, 
  0x00, 0x00, 0x00, 0x00, 0x00, 0x00, 0x00, 0x00, 0x00, 0x00, 0x00, 0x00, 0x00, 0x00, 0x00, 0x00, 
  0x00, 0x00, 0x00, 0x00, 0x00, 0x00, 0x00, 0x00, 0x00, 0x00, 0x00, 0x00, 0x00, 0x00, 0x00, 0x00, 
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  0x00, 0x00, 0x00, 0x00, 0x00, 0x00, 0x00, 0x00, 0x00, 0x00, 0x00, 0x00, 0x00, 0x00, 0x00, 0x00
};
const unsigned char BMO_Talk [] PROGMEM = {
  0x00, 0x00, 0x00, 0x00, 0x00, 0x00, 0x00, 0x00, 0x00, 0x00, 0x00, 0x00, 0x00, 0x00, 0x00, 0x00, 
  0x00, 0x00, 0x00, 0x00, 0x00, 0x00, 0x00, 0x00, 0x00, 0x00, 0x00, 0x00, 0x00, 0x00, 0x00, 0x00, 
  0x00, 0x00, 0x00, 0x00, 0x00, 0x00, 0x00, 0x00, 0x00, 0x00, 0x00, 0x00, 0x00, 0x00, 0x00, 0x00, 
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  0x00, 0x00, 0x00, 0x00, 0x00, 0x00, 0x00, 0x00, 0x00, 0x00, 0x00, 0x00, 0x00, 0x00, 0x00, 0x00
};
const unsigned char BMO_Smile [] PROGMEM = {
  0x00, 0x00, 0x00, 0x00, 0x00, 0x00, 0x00, 0x00, 0x00, 0x00, 0x00, 0x00, 0x00, 0x00, 0x00, 0x00, 
  0x00, 0x00, 0x00, 0x00, 0x00, 0x00, 0x00, 0x00, 0x00, 0x00, 0x00, 0x00, 0x00, 0x00, 0x00, 0x00, 
  0x00, 0x00, 0x00, 0x00, 0x00, 0x00, 0x00, 0x00, 0x00, 0x00, 0x00, 0x00, 0x00, 0x00, 0x00, 0x00, 
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  0x00, 0x00, 0x00, 0x00, 0x00, 0x00, 0x00, 0x00, 0x00, 0x00, 0x00, 0x00, 0x00, 0x00, 0x00, 0x00
};
const unsigned char BMO_Angry [] PROGMEM = {
  0x00, 0x00, 0x00, 0x00, 0x00, 0x00, 0x00, 0x00, 0x00, 0x00, 0x00, 0x00, 0x00, 0x00, 0x00, 0x00, 
  0x00, 0x00, 0x00, 0x00, 0x00, 0x00, 0x00, 0x00, 0x00, 0x00, 0x00, 0x00, 0x00, 0x00, 0x00, 0x00, 
  0x00, 0x00, 0x00, 0x00, 0x00, 0x00, 0x00, 0x00, 0x00, 0x00, 0x00, 0x00, 0x00, 0x00, 0x00, 0x00, 
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  0x00, 0x00, 0x00, 0x00, 0x00, 0x00, 0x00, 0x00, 0x00, 0x00, 0x00, 0x00, 0x00, 0x00, 0x00, 0x00
};
const unsigned char Oxygen [] PROGMEM = {
  0x00, 0x00, 0x00, 0x00, 0x00, 0x00, 0x00, 0x00, 0x00, 0x0f, 0x00, 0x18, 0x00, 0x00, 0x0f, 0x00, 
  0x3c, 0x00, 0x00, 0x0f, 0x00, 0x1c, 0x00, 0x00, 0x06, 0x3c, 0x00, 0x00, 0x00, 0xe0, 0x7e, 0x00, 
  0x00, 0x03, 0xf0, 0xff, 0x00, 0x00, 0x03, 0xf0, 0xff, 0x03, 0xff, 0x03, 0xf8, 0xff, 0x8f, 0xff, 
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  0xff, 0x00, 0x00, 0x00, 0x00, 0x00, 0x00, 0x00
};
const unsigned char Heart [] PROGMEM = {
  0x00, 0x00, 0x00, 0x00, 0x00, 0x00, 0x00, 0x00, 0x00, 0x00, 0x00, 0x00, 0x00, 0x00, 0x00, 0x00, 
  0x00, 0x00, 0x00, 0x00, 0x01, 0xff, 0x00, 0xff, 0x80, 0x07, 0xc7, 0xc3, 0xe3, 0xe0, 0x0e, 0x00, 
  0xe7, 0x00, 0x70, 0x1c, 0x00, 0x7e, 0x00, 0x38, 0x38, 0x00, 0x3c, 0x00, 0x18, 0x30, 0x00, 0x38, 
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  0x00, 0x00, 0x00, 0x00, 0x00, 0x00, 0x00, 0x00
};

void setup() 
{
  Serial.begin(115200);
  tft.initR(INITR_BLACKTAB);
  tft.fillScreen(BMO_COLOR);
  tft.setRotation(1);
  tft.setTextSize(2);
  tft.setTextColor(ST7735_BLACK);
  //while(Serial.read() != 'f'){
    tft.setCursor(10, 30);
    tft.println("INITIALIZING");
    tft.setCursor(45, 65);
    tft.println("SYSTEM");
  //}
  delay(20000);
  tft.fillScreen(BMO_COLOR);
}

void loop() 
{
  char buff = Serial.read();
  switch(buff) {
    case 'i':
      Serial.println("o");
    break;
    case 's':
      StartUpdate = handleCalibration();
      if(StartUpdate){
        setupFinalDisplay();
        sensor.resetFifo();
      }else{
        ErrorScreen();
        delay(3000);
      }
      while(Serial.read() != 'f' && StartUpdate) { 
        pox.update();
        if (millis() - tsLastReport > REPORTING_PERIOD_MS) {
          iBPM = pox.getHeartRate();
          Serial.println(iBPM);
          SPO2 = pox.getSpO2();
          if (SPO2 >= 100)
            SPO2 = 100;
          tsLastReport = millis();
          FirstSamples++;
        }
        if(FirstSamples > 8){
          if (((iBPM != iBPMOld) && (iBPM < UPPER_PULSE_RATE)) | (SPO2 != SPO2Old)) {
            if(iBPM >= 100)
              UpdateValues(60, 30, iBPMOld, iBPM, 20);
            else if(iBPM >= 10)
              UpdateValues(70, 30, iBPMOld, iBPM, 20);
            else
              UpdateValues(80, 30, iBPMOld, iBPM, 20);
            if(SPO2 >= 100)  
              UpdateValues(60, 85, SPO2Old, SPO2, 75);
            else if(SPO2 >= 10)  
              UpdateValues(75, 85, SPO2Old, SPO2, 75);
            else  
              UpdateValues(85, 85, SPO2Old, SPO2, 75);
            iBPMOld = iBPM;
            SPO2Old = SPO2;
          }
        }
      }
      FirstSamples = 0;
      pox.shutdown();
      tft.fillScreen(BMO_COLOR);
    break;
    case 'n':
      tft.fillScreen(BMO_COLOR);
      tft.setTextColor(ST7735_BLACK);
      tft.setTextSize(2);
      tft.setCursor(10, 30);
      while(Serial.read() != 'f'){
        tft.println("LOADING CARD");
        tft.setCursor(15, 70);
        tft.println("PLEASE WAIT");
        tft.setCursor(10, 30);  
      }
      tft.fillScreen(BMO_COLOR);
      tft.setCursor(15, 50);
      tft.println("CARD SAVED!");
      delay(2000);
      tft.fillScreen(BMO_COLOR);
    break;
    case 'h':
      tft.fillScreen(BMO_COLOR);
      tft.drawBitmap(0, 0, BMO_Blink, 160, 128, ST7735_BLACK);
      delay(700);
      tft.fillScreen(BMO_COLOR);
    break;
    case 'p':
      tft.fillScreen(BMO_COLOR);
      tft.drawBitmap(0, 0, BMO_Angry, 160, 128, ST7735_BLACK);
      delay(2000);
      tft.setTextColor(ST7735_BLACK);
      tft.setTextSize(3);
      tft.fillScreen(BMO_COLOR);
      tft.setCursor(10, 50);
      tft.println("POWEROFF");
      delay(10000);
      tft.fillScreen(BMO_COLOR);
    break;
    default:
      // read the analog in value:
      outputValue = analogRead(analogInPin);
      if((outputValue>=(MinAudioValue-5) && outputValue<=(MaxAudioValue+5))| FirstUpdate)
        tft.drawBitmap(0, 0, BMO_Smile, 160, 128, ST7735_BLACK);
      else {
        tft.drawBitmap(0, 0, BMO_Smile, 160, 128, ST7735_BLACK);
        delay(500);
        tft.fillScreen(BMO_COLOR);
        tft.drawBitmap(0, 0, BMO_Talk, 160, 128, ST7735_BLACK);
        delay(500);
        tft.fillScreen(BMO_COLOR);
        tft.drawBitmap(0, 0, BMO_Smile, 160, 128, ST7735_BLACK);
      }
      if (millis()-LastUpdate > UpdateAudioValue){
        for(int i; i<=100; i++){
          TempAudioValue = analogRead(analogInPin);
          if (TempAudioValue > MaxAudioValue)
            MaxAudioValue = TempAudioValue;
          if (TempAudioValue < MaxAudioValue)
            MinAudioValue = TempAudioValue;
          delay(10);
        }
        FirstUpdate = false;
        LastUpdate = millis();
      }
    break;
  }  
}

void UpdateValues(int x, int y, int OldValue, int NewValue, int YRect) 
{
  tft.setTextSize(3);
  tft.fillRect(52, YRect, 60, 40, ST7735_BLACK);//para bpm -> 20; para SPO2 -> 75
  tft.setCursor(x, y);
  tft.setTextColor(ST7735_YELLOW);
  sprintf(cStringArray,"%d",NewValue);
  tft.println(cStringArray);
}

boolean handleCalibration() 
{
  int iCountDown = 10; 
  char cCountDown[15];
  boolean SensorOK = false; 
  setupCalibrateDisplay1();
  tft.setTextSize(1);
  //Start sensor Configuration
  if (!pox.begin()) {
    Serial.println("FAILED");
  } else{
    Serial.println("SUCCESS");
    SensorOK = true;
  }
  while (iCountDown > 0 && SensorOK){
    tft.setTextColor(ST7735_WHITE);
    tft.setCursor(110,100);
    sprintf(cCountDown,"%d Secs",iCountDown);
    tft.println(cCountDown);
    delay(1000);
    tft.setTextColor(ST7735_BLACK);
    tft.setCursor(110,100);
    sprintf(cCountDown,"%d Secs",iCountDown);
    tft.println(cCountDown);
    iCountDown--;
  };
  return SensorOK;
}

void setupCalibrateDisplay1() 
{
  tft.fillScreen(ST7735_BLACK);
  tft.setCursor(35, 5);
  tft.setTextColor(ST7735_YELLOW);
  tft.setTextSize(2);
  tft.println("Ranging");
  tft.setCursor(28, 28);
  tft.println("Required");
  tft.setCursor(13,60);
  tft.setTextColor(ST7735_GREEN);
  tft.setTextSize(1);
  tft.println("Keep finger in sensor");
  tft.setCursor(20,70);
  tft.println("during calculation");
  tft.setCursor(10,100);
  tft.setTextColor(ST7735_RED);
  tft.setTextSize(1);
  tft.println("Calculation in :");
}

void setupFinalDisplay() 
{
  //ADICIONAR RETANGULOS -- --
  tft.fillScreen(ST7735_BLACK);
  tft.drawBitmap(10, 20, Heart, 40, 40, ST7735_RED);
  tft.fillRect(60, 40, 20, 5, ST7735_YELLOW);//ALTERAR POSICAO E TAMANHO  tft.fillRect(x, y, w, h, color)
  tft.fillRect(90, 40, 20, 5, ST7735_YELLOW);//ALTERAR POSICAO E TAMANHO
  tft.setTextColor(ST7735_CYAN);
  tft.setTextSize(2);
  tft.setCursor(120,40);
  tft.println("BPM");
  tft.drawBitmap(10, 70, Oxygen, 40, 40, ST7735_GREEN);
  tft.fillRect(60, 90, 20, 5, ST7735_YELLOW);//ALTERAR POSICAO E TAMANHO
  tft.fillRect(90, 90, 20, 5, ST7735_YELLOW);//ALTERAR POSICAO E TAMANHO
  tft.setCursor(130,90);
  tft.println("%");
}

void ErrorScreen(){
  tft.fillScreen(BMO_COLOR);
  tft.setTextSize(2);
  tft.setTextColor(ST7735_BLACK);
  tft.setCursor(15, 30);
  tft.println("SENSOR FAIL");
  tft.setCursor(25, 70);
  tft.println("TRY AGAIN"); 
}
